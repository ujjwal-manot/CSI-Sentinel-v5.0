## firmware/esp32_csi/sdkconfig.defaults
```kconfig
CONFIG_ESP32_WIFI_CSI_ENABLED=y
CONFIG_ESP32_WIFI_AMPDU_TX_ENABLED=n
CONFIG_ESP32_WIFI_AMPDU_RX_ENABLED=n
CONFIG_ESP32_WIFI_NVS_ENABLED=y
CONFIG_LWIP_UDP_RECVMBOX_SIZE=32
CONFIG_ESP_WIFI_SOFTAP_SUPPORT=y
CONFIG_FREERTOS_HZ=1000
CONFIG_ESP32_DEFAULT_CPU_FREQ_240=y
CONFIG_ESP32_DEFAULT_CPU_FREQ_MHZ=240
```
